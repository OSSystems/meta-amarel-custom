## conf/layer.conf
```bitbake
# We have a conf and classes directory, add to BBPATH
BBPATH .= ":${LAYERDIR}"

# We have recipes-* directories, add to BBFILES
BBFILES += "${LAYERDIR}/recipes-*/*/*.bb \
	${LAYERDIR}/recipes-*/*/*.bbappend"




BBFILE_COLLECTIONS += "amarel-custom"
BBFILE_PATTERN_amarel-custom = "^${LAYERDIR}/"
BBFILE_PRIORITY_amarel-custom = "12"
IMAGE_INSTALL_append = " linux-firmware-usb8897"
IMAGE_ROOTFS_EXTRA_SPACE = "2097152"
KERNEL_MODULE_AUTOLOAD += "ads7846"
IMAGE_INSTALL_append = " hostapd dnsmasq iproute2"
IMAGE_INSTALL_remove = " msc-wallpaper"
IMAGE_INSTALL_append = " cronie mysql5"
IMAGE_INSTALL_append = " python-argparse"
IMAGE_INSTALL_append = " python-json python-requests python-email python-urllib3 python-pybluez"
DISTRO_FEATURES_remove += " x11"
PACKAGECONFIG_DISTRO_append_pn-qtbase = " accessibility"
DISTRO_FEATURES_append = " bluetooth bluez5 "
#In order to build them you need to enable "oracle-java" license
#LICENSE_FLAGS_WHITELIST += "oracle_java"

IMAGE_INSTALL_append += " mariadb"
IMAGE_INSTALL_append += " ppp"
IMAGE_INSTALL_append += " quectel-ppp nano file memtester stress tcpdump minicom openssl gpioscript iptables i2c-tools mtd-utils-ubifs mtd-utils-misc "


# User configuration should be placed below this line
PREFERRED_PROVIDER_virtual/java-initial-native = "cacao-initial-native"
PREFERRED_PROVIDER_virtual/java-native = "cacao-native"
CORE_IMAGE_EXTRA_INSTALL += "openjre-8 openjdk-8"
```
